
#include <setting.h>
#include <includes.h>

#define motorState_mem 1
#define maxDistance_mem 2
#define minDistance_mem 3
#define MotorStartThreshold_mem 4
#define manualOff_mem 5
#define LastMotorState_mem 6
#define dryRun_LastDistance_mem 7
#define StatorType_mem 8
#define AutoMode_mem 9

int MinDistance;
int MotorStartThreshold;
int MaxDistance, value, LastValue;
uint8_t STATOR_TYPE;
uint8_t errorCount;
uint8_t ledBlink;
int Distance, DistanceX;
#ifdef DryRun
int dryRun_timer;
#endif
uint8_t dryRun_Distance(0),
    dryRun_LastDistance(0);
#ifdef web_setting
extern const char index_html[];
#endif
const byte DNS_PORT = 53;

const unsigned long LONG_PRESS(2000);

bool MotorState, LastMotorState;
bool AutoMode = false;
bool ManualOff = false;
bool blink_state = false;
bool errorCountState, LasterrorCountState;
bool WiFiState;
bool DryRunState;
bool MQTT = false;
long duration;

String Command;
unsigned char data[4] = {};
#if OLED
const uint8_t mdtronix_icon[] PROGMEM = {0x00, 0x00, 0x0c, 0x00, 0x00, 0x20, 0x00, 0x00, 0x00, 0x00, 0x1f, 0x00, 0x00,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 0x00, 0x00};
const uint8_t network_icon[] PROGMEM = {0x00, 0x80, 0x01, 0xc0, 0x33, 0xe0, 0x37, 0xf0, 0x37, 0xf0, 0x30, 0xc0, 0x30, 0xc0, 0xfe, 0xc0, 0xfe, 0xc0, 0x7c, 0xc0, 0x38, 0x00, 0x10, 0x00};
const uint8_t alert_icon[] = {0x00, 0x00, 0x00, 0x00, 0x00, 0x00, 0x00, 0x00, 0x00, 0x00, 0x00, 0x00, 0x00,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 0x00, 0x00};
#else
byte BlinkUp[] = {B11111, B11111, B11111, B11111,
                  B00000, B00000, B00000, B00000};

byte BlinkDown[] = {B00000, B00000, B00000, B00000,
                    B11111, B11111, B11111, B11111};

byte ManualOff_char[] = {
    0x02,
    0x02,
    0x06,
    0x1F,
    0x1F,
    0x1E,
    0x0E,
    0x0E};
byte network_icon[] = {
    0x00,
    0x0A,
    0x0B,
    0x0A,
    0x0A,
    0x1A,
    0x0A,
    0x00};
#endif

#if HA_INIT
#define DEVICE_VERSION _VERSION
#define DEVICE_MANUFACTURER "MDtronix Lab"
#define DEVICE_MODEL "WaterTank Controller: v9.0"

#define BROKER_USER "hassio"
#define BROKER_PASS "darkmaster"

#define DEVICE_NAME "MDtronix WTLC"
#define pump_name "WaterTank Pump"
#define mode_name "WaterTank Auto"
#define distance_name "WaterTank Distance"
#define level_name "WaterTank Level"
#define SensorError_name "WaterTank Sensor"

HADevice device;
HAMqtt mqtt_HA(client, device);
HASwitch pump_HA("Pump", false);
HASwitch mode_HA("Mode", false);
HASensor value_HA("Level");
HASensor distance_HA("Distance");
HASensor sensor_error_HA("System");

// #else
// Card LEVEL_DASH(&dashboard, HUMIDITY_CARD, "Level", "%", 0, 100);
// Card MODE_DASH(&dashboard, BUTTON_CARD, "Mode");
// Card PUMP_DASH(&dashboard, BUTTON_CARD, "Pump");
#endif

#include <headers.h>

void setup()
{
  EEPROM.begin(32);
  Serial.begin(115200);
#if OLED
  if (!display.begin(SSD1306_SWITCHCAPVCC, SCREEN_ADDRESS))
  {
    Serial.println(F("SSD1306 allocation failed"));
    for (;;)
      ; // Don't proceed, loop forever
  }
#else
  lcd.init();
  lcd.backlight();
  lcd.createChar(0, BlinkUp);
  lcd.createChar(1, BlinkDown);
  lcd.createChar(2, ManualOff_char);
  lcd.createChar(3, network_icon);
#endif
#if SENSOR_1
#elif SENSOR_2
  sensorSerial.begin(9600);
#elif SENSOR_3
  pinMode(TRIGGER_PIN, OUTPUT);
  pinMode(PWM_OUTPUT_PIN, INPUT);
#endif
  ReadMem();
  button.begin();
  modeButton.begin();
  pinMode(led, OUTPUT);
  pinMode(buzz, OUTPUT);
  pinMode(Relay_ON, OUTPUT);
  pinMode(Relay_ON_2, OUTPUT);
  pinMode(Relay_OFF, OUTPUT);
  if (ManualOff == false && AutoMode == true)
  {
    AutoMode = true;
  }
  else
  {
    AutoMode = false;
  }
  StartUp();
  if (MotorState == true && ManualOff == false && AutoMode == true)
  {
    debugln("turning motor on");
    LastMotorState = false;
    PumpON_command();
  }
  else
  {
    PumpOFF_command();
  }
  t.every(100, readSensor);
  t.every(500, update_lcd);
#if debugData
  t.every(1000, Debug);
#endif

  mySensor.begin(SMOOTHED_AVERAGE, 50);
  // mySensor.clear();
  WIFI_CONNECT();
#if HA_INIT
  set_device();
  mqtt_HA.begin(BROKER_ADDR, BROKER_USER, BROKER_PASS);
// #else
// PUMP_DASH.attachCallback([&](bool value)
//                          {
//                            if (value == true)
//                            {
//                               ManualOff = false;
//                               DryRunState = false;
//                               errorCountState = false;
//                               EEPROM.write(manualOff_mem, 0);
//                               EEPROM.commit();
//                               PumpON_command();
//                               if (AutoMode == false && modeButton.isPressed())
//                               {
//                                   AutoMode = true;
//                                   EEPROM.write(AutoMode_mem,AutoMode);
//                                   EEPROM.commit();
//                               }
//                            }
//                            else
//                            {
//                              if (value >= MotorStartThreshold)
//                              {
//                                ManualOff = false;
//                                EEPROM.write(manualOff_mem, 0);
//                                EEPROM.commit();
//                              }
//                              else
//                              {
//                                ManualOff = true;
//                                AutoMode = false;
//                                EEPROM.write(manualOff_mem, 1);
//                                EEPROM.commit();
//                              }
//                            PumpOFF_command();
//                            } });
// MODE_DASH.attachCallback([&](bool value)
//                          {
//                            if(value==true)
//                            {
//                              AutoMode=true;
//                            }
//                            else
//                            {
//                              AutoMode=false;
//                            }
//                            EEPROM.write(AutoMode_mem,AutoMode);
//                            EEPROM.commit();
//                            MODE_DASH.update(AutoMode);
//                            dashboard.sendUpdates(); });
#endif
  setting_code();
}

void loop()
{
  t.update();
  button.read();
  modeButton.read();
  lcdDefault();
  buttonEvent();
  OneTimeRun();
  if (ManualOff == true)
  {
#if OLED
#else
    lcd.setCursor(14, 1);
    lcd.write(2);
#endif
  }
  else
  {
#if OLED
#else
    lcd.setCursor(14, 1);
    lcd.print(" ");
#endif
  }
#if HA_INIT
  mqtt_HA.loop();
  if (mqtt_HA.isConnected())
  {
#if OLED
    MQTT = true;
#else
    lcd.setCursor(13, 1);
    lcd.write(3);
#endif
  }
  else
  {
#if OLED
    MQTT = false;
#else
    lcd.setCursor(13, 1);
    lcd.print(" ");
#endif
  }
// #else
//   MODE_DASH.update(AutoMode);
//   if (!errorCountState)
//     LEVEL_DASH.update(value, "%");
//   else
//     LEVEL_DASH.update("Error");
//   dashboard.sendUpdates();
#endif
#if WM_SET
  wm.process();
#endif
  MDNS.update();
  EEPROM.write(manualOff_mem, ManualOff);
  EEPROM.write(AutoMode_mem, AutoMode);
  EEPROM.write(dryRun_LastDistance_mem, dryRun_LastDistance);
  EEPROM.write(LastMotorState_mem, LastMotorState);
  EEPROM.write(motorState_mem, MotorState);
  EEPROM.write(minDistance_mem, MinDistance);
  EEPROM.write(maxDistance_mem, MaxDistance);
  EEPROM.write(MotorStartThreshold_mem, MotorStartThreshold);
  EEPROM.write(StatorType_mem, STATOR_TYPE);
  EEPROM.commit();
}